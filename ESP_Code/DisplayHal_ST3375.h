#ifndef DISPLAY_HAL_ST3375_H
#define DISPLAY_HAL_ST3375_H

#define TFT_DUCO_ORANGE 0xebc8
#define TFT_DUCO_GRAY 0x2987

static const unsigned char image_network_1_bar_bits[] PROGMEM = {0x00,0x70,0x00,0x50,0x00,0x50,0x00,0x50,0x00,0x57,0x00,0x55,0x00,0x55,0x00,0x55,0x70,0x55,0x50,0x55,0x50,0x55,0x50,0x55,0x57,0x55,0x57,0x55,0x77,0x77,0x00,0x00};
static const unsigned char image_network_2_bars_bits[] PROGMEM = {0x00,0x70,0x00,0x50,0x00,0x50,0x00,0x50,0x00,0x57,0x00,0x55,0x00,0x55,0x00,0x55,0x70,0x55,0x70,0x55,0x70,0x55,0x70,0x55,0x77,0x55,0x77,0x55,0x77,0x77,0x00,0x00};
static const unsigned char image_network_3_bars_bits[] PROGMEM = {0x00,0x70,0x00,0x50,0x00,0x50,0x00,0x50,0x00,0x57,0x00,0x57,0x00,0x57,0x00,0x57,0x70,0x57,0x70,0x57,0x70,0x57,0x70,0x57,0x77,0x57,0x77,0x57,0x77,0x77,0x00,0x00};
static const unsigned char image_network_4_bars_bits[] PROGMEM = {0x00,0x70,0x00,0x70,0x00,0x70,0x00,0x70,0x00,0x77,0x00,0x77,0x00,0x77,0x00,0x77,0x70,0x77,0x70,0x77,0x70,0x77,0x70,0x77,0x77,0x77,0x77,0x77,0x77,0x77,0x00,0x00};
static const uint16_t duco_alt_small[] PROGMEM  = {0x0000, 0x0000, 0x0000, 0x0000, 0x0000, 0x0000, 0x0000, 0x0000, 0x0000, 0x0000, 0x0000, 0x0000, 0x0000,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 0x0000, 0x0000};
static const uint16_t duco_logo_large[] PROGMEM  = {
  0x0000, 0x0000, 0x0000, 0x0000, 0x0000, 0x0000, 0x0000, 0x0000, 0x0000, 0x0000, 0x0000, 0x0000,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 0x0000
};

void screen_setup() {
  tft.init();
  tft.setRotation(1);
  tft.fillScreen(TFT_BLACK);

  tft_buffer.createSprite(160, 80);

  tft_info_buffer.createSprite(160, 80);
  tft_info_buffer.fillSprite(TFT_BLACK);
  tft_info_buffer.setTextColor(TFT_WHITE, TFT_BLACK);
  tft_info_buffer.pushImage(0, 0, 17, 17, duco_alt_small);
  tft_info_buffer.drawString("DUCO MINER " + String(SOFTWARE_VERSION), 19, 0, 2);
  tft_info_buffer.drawLine(0, 18, 160, 18, TFT_DUCO_GRAY);
  tft_info_buffer.setViewport(0, 20, 160, 60);
  tft_info_buffer.setTextFont(1);
  tft_info_buffer.setTextWrap(true, false);
  tft_info_buffer.setTextColor(TFT_WHITE, TFT_BLACK);

  pinMode(38, OUTPUT);
  digitalWrite(38, 0);
}

void display_boot() {
  tft_buffer.fillSprite(TFT_BLACK);
  tft.setTextColor(TFT_WHITE, TFT_BLACK);

  tft_buffer.pushImage(0, 20, 40, 40, duco_logo_large);

  tft_buffer.setViewport(45, 10, 115, 60);
  tft_buffer.setCursor(0, 0);
  tft_buffer.setTextFont(2);
  tft_buffer.println("DUCO MINER " + String(SOFTWARE_VERSION));
  tft_buffer.setTextFont(1);
  tft_buffer.println(getChipModel() + " " + getCpuFrequencyMhz() + " MHz");
  tft_buffer.println("Built " + String(__DATE__));
  tft_buffer.println("Features:");
  tft_buffer.println(get_features_str());
  tft_buffer.resetViewport();

  tft_buffer.pushSprite(0, 0);
}

void display_info_i(const String& message) {
	const int h = 60;
  const int w = 160;
  const int fh = tft_info_buffer.fontHeight();

  const int textPixelWidth = tft_info_buffer.textWidth(message);
  const int linesNeeded = (textPixelWidth / w) + 1;
  const int totalHeightNeeded = linesNeeded * fh;

  const int currentY = tft_info_buffer.getCursorY();
  const int spaceRemaining = h - currentY;

  // Message exceeds available space, just render the end of it
  if (totalHeightNeeded > h) {
    tft_info_buffer.fillSprite(TFT_BLACK);
    tft_info_buffer.setCursor(0, h - totalHeightNeeded);
  }
  // Message fits, but we need to scroll to make space
  else if (totalHeightNeeded > spaceRemaining) {
    const int scrollAmount = totalHeightNeeded - spaceRemaining;
    tft_info_buffer.scroll(0, -scrollAmount);

    tft_info_buffer.setCursor(tft_info_buffer.getCursorX(), currentY - scrollAmount);

    tft_info_buffer.fillRect(0, h - scrollAmount, w, scrollAmount, TFT_BLACK);
  }

  tft_info_buffer.println(message);
  tft_info_buffer.pushSprite(0, 0);
}

void display_mining_results_i(const String& hashrate, const String& accepted_shares, const String& total_shares, const String& uptime, const String& node, 
                                const String& difficulty, const String& sharerate, const String& ping, const String& accept_rate) {
	tft_buffer.fillSprite(TFT_BLACK);
  tft_buffer.setTextColor(TFT_WHITE, TFT_BLACK);
  tft_buffer.pushImage(0, 0, 17, 17, duco_alt_small);
  tft_buffer.drawString("DUCO MINER " + String(SOFTWARE_VERSION), 19, 0, 2);
  tft_buffer.drawLine(0, 18, 160, 18, TFT_DUCO_GRAY);

  // Network
  if (WiFi.RSSI() > -40) {
    tft_buffer.drawXBitmap(144, 0, image_network_4_bars_bits, 15, 16, TFT_GREEN);
  } else if (WiFi.RSSI() > -60) {
    tft_buffer.drawXBitmap(144, 0, image_network_3_bars_bits, 15, 16, TFT_GREEN);
  } else if (WiFi.RSSI() > -75) {
    tft_buffer.drawXBitmap(144, 0, image_network_2_bars_bits, 15, 16, TFT_YELLOW);
  } else {
    tft_buffer.drawXBitmap(144, 0, image_network_1_bar_bits, 15, 16, TFT_RED);
  }
  tft_buffer.setTextDatum(MR_DATUM);
  tft_buffer.drawString(ping, 144, 9, 1);
  tft_buffer.setTextDatum(TL_DATUM);

  // Lines
  tft_buffer.drawLine(80, 18, 80, 80, TFT_DUCO_GRAY);
  tft_buffer.drawLine(0, 58, 160, 58, TFT_DUCO_GRAY);

  // Hashrate
  tft_buffer.setTextColor(TFT_DUCO_ORANGE, TFT_BLACK);
  tft_buffer.drawString("HR:", 0, 22, 1);
  tft_buffer.drawString(hashrate, 0, 30, 4);

  // Shares
  tft_buffer.setTextColor(TFT_WHITE, TFT_BLACK);
  tft_buffer.drawString("Shares:", 84, 22, 1);
  tft_buffer.drawString(accepted_shares + " act", 84, 31, 1);
  tft_buffer.drawString(total_shares + " tot", 84, 40, 1);
  tft_buffer.drawString(sharerate + " rte", 84, 48, 1);

  // Uptime
  tft_buffer.drawString("Uptime:", 0, 60, 1);
  tft_buffer.drawString(uptime, 0, 69, 1);

  // Difficulty
  tft_buffer.drawString("Diff:", 84, 60, 1);
  tft_buffer.drawString(difficulty, 84, 69, 1);

  tft_buffer.pushSprite(0, 0);
}

#endif